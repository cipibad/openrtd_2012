## configs/Eboda_500_dsview_defconfig
```kconfig
BR2_mipsel=y
BR2_TOOLCHAIN_EXTERNAL=y
BR2_TOOLCHAIN_EXTERNAL_CUSTOM=y
BR2_TOOLCHAIN_EXTERNAL_PATH="$(TOPDIR)/toolchain_mipsel"
BR2_TOOLCHAIN_EXTERNAL_LARGEFILE=y
BR2_TOOLCHAIN_EXTERNAL_WCHAR=y
BR2_TOOLCHAIN_EXTERNAL_CXX=y
# BR2_USE_MMU is not set
BR2_ROOTFS_DEVICE_TABLE="target/generic/device_table_mp.txt"
BR2_ROOTFS_STATIC_DEVICE_TABLE="target/generic/device_table_dev_mp.txt"
BR2_ROOTFS_SKELETON_CUSTOM=y
BR2_ROOTFS_SKELETON_CUSTOM_PATH="fs/cb3pp"
# BR2_PACKAGE_BUSYBOX is not set
BR2_PACKAGE_CUSTOMIZE=y
BR2_PACKAGE_PHP=y
BR2_PACKAGE_OPENSSL=y
BR2_PACKAGE_LIBCURL=y
BR2_PACKAGE_LIBEVENT=y
BR2_PACKAGE_LIBGLIB2=y
BR2_PACKAGE_SLANG=y
BR2_PACKAGE_BTPD=y
BR2_PACKAGE_LIGHTTPD=y
BR2_PACKAGE_IPKG=y
BR2_PACKAGE_BASH=y
BR2_PACKAGE_DTACH=y
BR2_PACKAGE_MC=y
BR2_TARGET_ROOTFS_RTDIMG=y
BR2_TARGET_ROOTFS_RTDIMG_PLAYER_CUSTOM=y
BR2_TARGET_ROOTFS_RTDIMG_PLAYER_CUSTOM_FW_PATH="/udir/cbadescu/mediaplayer/buildroot/firmware/hd500/install.img"
BR2_TARGET_ROOTFS_RTDIMG_PLAYER_CUSTOM_BASE_VERSION_500=y
BR2_TARGET_ROOTFS_RTDIMG_PLAYER_CUSTOM_OVERWRITE_RSSMENU_DS=y
BR2_TARGET_ROOTFS_RTDIMG_PLAYER_CUSTOM_UPDATE_BINARIES=y
BR2_TARGET_ROOTFS_RTDIMG_PLAYER_CUSTOM_INSTALL_WEB_CONTROL_PANEL=y
BR2_TARGET_ROOTFS_RTDIMG_PLAYER_CUSTOM_INSTALL_CB3PP_BINARIES=y
BR2_TARGET_ROOTFS_RTDIMG_PLAYER_CUSTOM_MOVE_RSS_MENU=y
BR2_TARGET_ROOTFS_RTDIMG_PLAYER_CUSTOM_PATCH_WEATHER=y
```

## configs/Eboda_500_mini_lo_preparation_defconfig
```kconfig
BR2_mipsel=y
BR2_TOOLCHAIN_EXTERNAL=y
BR2_TOOLCHAIN_EXTERNAL_CUSTOM=y
BR2_TOOLCHAIN_EXTERNAL_PATH="$(TOPDIR)/toolchain_mipsel"
BR2_TOOLCHAIN_EXTERNAL_LARGEFILE=y
BR2_TOOLCHAIN_EXTERNAL_WCHAR=y
BR2_TOOLCHAIN_EXTERNAL_CXX=y
# BR2_USE_MMU is not set
BR2_ROOTFS_DEVICE_TABLE="target/generic/device_table_mp.txt"
BR2_ROOTFS_STATIC_DEVICE_TABLE="target/generic/device_table_dev_mp.txt"
BR2_ROOTFS_SKELETON_CUSTOM=y
BR2_ROOTFS_SKELETON_CUSTOM_PATH="fs/cb3pp"
# BR2_PACKAGE_BUSYBOX is not set
BR2_PACKAGE_CUSTOMIZE=y
BR2_PACKAGE_STRACE=y
BR2_PACKAGE_GAWK=y
BR2_PACKAGE_PHP=y
BR2_PACKAGE_OPENSSL=y
BR2_PACKAGE_LIBCURL=y
BR2_PACKAGE_LIBEVENT=y
BR2_PACKAGE_LIBGLIB2=y
BR2_PACKAGE_SLANG=y
BR2_PACKAGE_BTPD=y
BR2_PACKAGE_LIGHTTPD=y
BR2_PACKAGE_IPKG=y
BR2_PACKAGE_BASH=y
BR2_PACKAGE_DTACH=y
BR2_PACKAGE_MC=y
BR2_TARGET_ROOTFS_RTDIMG=y
BR2_TARGET_ROOTFS_RTDIMG_PLAYER_CUSTOM=y
BR2_TARGET_ROOTFS_RTDIMG_PLAYER_CUSTOM_FW_PATH="/udir/cbadescu/mediaplayer/buildroot/firmware/hd500/install.img"
BR2_TARGET_ROOTFS_RTDIMG_PLAYER_CUSTOM_BASE_VERSION_500=y
BR2_TARGET_ROOTFS_RTDIMG_PLAYER_CUSTOM_INSTALL_TARGET_PACKAGES=y
BR2_LINUX_KERNEL=y
BR2_LINUX_KERNEL_CUSTOM_TARBALL=y
BR2_LINUX_KERNEL_CUSTOM_TARBALL_LOCATION="file://kernel/OPlayAir_V1_28_GPL/linux-2.6.12.314723.tgz"
BR2_LINUX_KERNEL_PATCH="kernel/OPlayAir_V1_28_GPL/patches"
BR2_LINUX_KERNEL_USE_CUSTOM_CONFIG=y
BR2_LINUX_KERNEL_CUSTOM_CONFIG_FILE="kernel/OPlayAir_V1_28_GPL/config.develop.avhdd.mars.old"
```

## configs/Eboda_500_working_defconfig
```kconfig
BR2_mipsel=y
BR2_TOOLCHAIN_EXTERNAL=y
BR2_TOOLCHAIN_EXTERNAL_CUSTOM=y
BR2_TOOLCHAIN_EXTERNAL_PATH="$(TOPDIR)/toolchain_mipsel"
BR2_TOOLCHAIN_EXTERNAL_LARGEFILE=y
BR2_TOOLCHAIN_EXTERNAL_WCHAR=y
BR2_TOOLCHAIN_EXTERNAL_CXX=y
# BR2_USE_MMU is not set
BR2_ROOTFS_DEVICE_TABLE="target/generic/device_table_mp.txt"
BR2_ROOTFS_STATIC_DEVICE_TABLE="target/generic/device_table_dev_mp.txt"
BR2_ROOTFS_SKELETON_CUSTOM=y
BR2_ROOTFS_SKELETON_CUSTOM_PATH="fs/cb3pp"
# BR2_PACKAGE_BUSYBOX is not set
BR2_PACKAGE_NZBGET=y
BR2_PACKAGE_UNRAR=y
BR2_PACKAGE_STRACE=y
BR2_PACKAGE_PHP=y
BR2_PACKAGE_PHP_EXT_PCRE=y
BR2_PACKAGE_PHPFM=y
BR2_PACKAGE_LIBGLIB2=y
BR2_PACKAGE_SLANG=y
BR2_PACKAGE_BTPD=y
BR2_PACKAGE_LIGHTTPD=y
BR2_PACKAGE_TRANSMISSION=y
BR2_PACKAGE_TRANSMISSION_DAEMON=y
BR2_PACKAGE_TRANSMISSION_DAEMON_OPENRTD_STARTUP_SCRIPT=y
BR2_PACKAGE_IPKG=y
BR2_PACKAGE_BASH=y
BR2_PACKAGE_DTACH=y
BR2_PACKAGE_MC=y
BR2_TARGET_ROOTFS_RTDIMG=y
BR2_TARGET_ROOTFS_RTDIMG_PLAYER_CUSTOM_FW_PATH="/udir/cbadescu/mediaplayer/buildroot/firmware/hd500/install.img"
BR2_TARGET_ROOTFS_RTDIMG_PLAYER_CUSTOM_OVERWRITE_RSSMENU=y
BR2_TARGET_ROOTFS_RTDIMG_PLAYER_CUSTOM_MOVE_RSS_MENU=y
BR2_TARGET_ROOTFS_RTDIMG_PLAYER_CUSTOM_PATCH_WEATHER=y
```

## configs/Eboda_HD_for_All_500_mini_defconfig
```kconfig
BR2_mipsel=y
BR2_TOOLCHAIN_EXTERNAL=y
BR2_TOOLCHAIN_EXTERNAL_CUSTOM=y
BR2_TOOLCHAIN_EXTERNAL_PATH="$(TOPDIR)/toolchain_mipsel"
BR2_TOOLCHAIN_EXTERNAL_LARGEFILE=y
BR2_TOOLCHAIN_EXTERNAL_WCHAR=y
BR2_TOOLCHAIN_EXTERNAL_CXX=y
# BR2_USE_MMU is not set
BR2_ROOTFS_DEVICE_TABLE="target/generic/device_table_mp.txt"
BR2_ROOTFS_STATIC_DEVICE_TABLE="target/generic/device_table_dev_mp.txt"
BR2_ROOTFS_SKELETON_CUSTOM=y
BR2_ROOTFS_SKELETON_CUSTOM_PATH="fs/cb3pp"
# BR2_PACKAGE_BUSYBOX is not set
BR2_PACKAGE_CUSTOMIZE=y
BR2_PACKAGE_PHP=y
BR2_PACKAGE_OPENSSL=y
BR2_PACKAGE_LIBCURL=y
BR2_PACKAGE_LIBEVENT=y
BR2_PACKAGE_LIBGLIB2=y
BR2_PACKAGE_SLANG=y
BR2_PACKAGE_BTPD=y
BR2_PACKAGE_LIGHTTPD=y
BR2_PACKAGE_IPKG=y
BR2_PACKAGE_BASH=y
BR2_PACKAGE_DTACH=y
BR2_PACKAGE_MC=y
BR2_LINUX_KERNEL=y
BR2_LINUX_KERNEL_CUSTOM_TARBALL=y
BR2_LINUX_KERNEL_CUSTOM_TARBALL_LOCATION="file://kernel/OPlayAir_V1_28_GPL/linux-2.6.12.314723.tgz"
BR2_LINUX_KERNEL_PATCH="kernel/OPlayAir_V1_28_GPL/cipibad.patch"
BR2_LINUX_KERNEL_USE_CUSTOM_CONFIG=y
BR2_LINUX_KERNEL_CUSTOM_CONFIG_FILE="kernel/OPlayAir_V1_28_GPL/config.develop.avhdd.mars.old"
BR2_LINUX_KERNEL_IMAGE_TARGET_CUSTOM=y
BR2_LINUX_KERNEL_IMAGE_TARGET_NAME="../../../vmlinux"
```

## fs/rtdimg/Config.in
```kconfig
config BR2_TARGET_ROOTFS_RTDIMG
  bool "install.img"
  help
    Build an install.img specific to Realtek based mediaplayers

if BR2_TARGET_ROOTFS_RTDIMG

  config BR2_TARGET_ROOTFS_RTDIMG_PLAYER_CUSTOM_FW_PATH
    string "Path to original firmware file install.img"


  config BR2_TARGET_ROOTFS_RTDIMG_PLAYER_CUSTOM_OVERWRITE_INSTALL
    bool "Overwrite install_a from firmware"

  if BR2_TARGET_ROOTFS_RTDIMG_PLAYER_CUSTOM_OVERWRITE_INSTALL

    choice
      prompt "New install_a"

      config BR2_TARGET_ROOTFS_RTDIMG_PLAYER_CUSTOM_OVERWRITE_EBODA_INSTALL
        bool "Overwrite with E-boda install_a"
      config BR2_TARGET_ROOTFS_RTDIMG_PLAYER_CUSTOM_OVERWRITE_MEDE8ER_INSTALL
        bool "Overwrite with Mede8er install_a"	
      config BR2_TARGET_ROOTFS_RTDIMG_PLAYER_CUSTOM_OVERWRITE_OTHER_INSTALL
        bool "Other install_a"
    endchoice

    if BR2_TARGET_ROOTFS_RTDIMG_PLAYER_CUSTOM_OVERWRITE_OTHER_INSTALL

      config BR2_TARGET_ROOTFS_RTDIMG_PLAYER_CUSTOM_OVERWRITE_OTHER_INSTALL_PATH
        string "Path to new install_a"


    endif #BR2_TARGET_ROOTFS_RTDIMG_PLAYER_CUSTOM_OVERWRITE_OTHER_INSTALL

  endif #BR2_TARGET_ROOTFS_RTDIMG_PLAYER_CUSTOM_OVERWRITE_INSTALL


choice
  prompt "Overwrite RSS Menu"

  config BR2_TARGET_ROOTFS_RTDIMG_PLAYER_CUSTOM_NO_OVERWRITE_RSSMENU
    bool "Keep original RSS menu"


  config BR2_TARGET_ROOTFS_RTDIMG_PLAYER_CUSTOM_OVERWRITE_RSSMENU
    bool "IMS RSS menu"

  if BR2_TARGET_ROOTFS_RTDIMG_PLAYER_CUSTOM_OVERWRITE_RSSMENU

    choice
      prompt "New rss menu" 

      config BR2_TARGET_ROOTFS_RTDIMG_PLAYER_CUSTOM_OVERWRITE_EBODA_HD500_RSSMENU
        bool "Overwrite with E-boda hd500 menu"
      config BR2_TARGET_ROOTFS_RTDIMG_PLAYER_CUSTOM_OVERWRITE_EBODA_HD600_RSSMENU
        bool "Overwrite with E-boda hd600 menu"
      config BR2_TARGET_ROOTFS_RTDIMG_PLAYER_CUSTOM_OVERWRITE_ACRYAN_RSSMENU
        bool "Overwrite with ACRyan menu"
      config BR2_TARGET_ROOTFS_RTDIMG_PLAYER_CUSTOM_OVERWRITE_OPLAY_RSSMENU
        bool "Overwrite with Asus O!Play menu"
      config BR2_TARGET_ROOTFS_RTDIMG_PLAYER_CUSTOM_OVERWRITE_EGREAT_RSSMENU
        bool "Overwrite with Egreat menu"
 
      config BR2_TARGET_ROOTFS_RTDIMG_PLAYER_CUSTOM_OVERWRITE_OTHER_RSSMENU
        bool "Other rss menu"
    endchoice
      
    if BR2_TARGET_ROOTFS_RTDIMG_PLAYER_CUSTOM_OVERWRITE_OTHER_RSSMENU
  
      config BR2_TARGET_ROOTFS_RTDIMG_PLAYER_CUSTOM_OVERWRITE_OTHER_RSSMENU_PATH
      string "Path to new rss menu"


    endif #BR2_TARGET_ROOTFS_RTDIMG_PLAYER_CUSTOM_OVERWRITE_OTHER_RSSMENU

  endif #BR2_TARGET_ROOTFS_RTDIMG_PLAYER_CUSTOM_OVERWRITE_RSSMENU

  config BR2_TARGET_ROOTFS_RTDIMG_PLAYER_CUSTOM_OVERWRITE_RSSMENU_DS
    bool "DS RSS menu"

  if BR2_TARGET_ROOTFS_RTDIMG_PLAYER_CUSTOM_OVERWRITE_RSSMENU_DS

    choice
      prompt "New DS rss menu"

      config BR2_TARGET_ROOTFS_RTDIMG_PLAYER_CUSTOM_OVERWRITE_EBODA_RSSMENU_DS
        bool "Overwrite with E-boda DS menu"
      config BR2_TARGET_ROOTFS_RTDIMG_PLAYER_CUSTOM_OVERWRITE_ACRYAN_RSSMENU_DS
        bool "Overwrite with ACRyan DS menu"
      config BR2_TARGET_ROOTFS_RTDIMG_PLAYER_CUSTOM_OVERWRITE_OPLAY_RSSMENU_DS
        bool "Overwrite with Asus O!Play DS menu"
      config BR2_TARGET_ROOTFS_RTDIMG_PLAYER_CUSTOM_OVERWRITE_EGREAT_RSSMENU_DS
        bool "Overwrite with Egreat DS menu"

      config BR2_TARGET_ROOTFS_RTDIMG_PLAYER_CUSTOM_OVERWRITE_OTHER_RSSMENU_DS
       	bool "Other DS rss menu"
    endchoice

    if BR2_TARGET_ROOTFS_RTDIMG_PLAYER_CUSTOM_OVERWRITE_OTHER_RSSMENU_DS

      config BR2_TARGET_ROOTFS_RTDIMG_PLAYER_CUSTOM_OVERWRITE_OTHER_RSSMENU_PATH_DS
        string "Path to new rss DS menu"


    endif #BR2_TARGET_ROOTFS_RTDIMG_PLAYER_CUSTOM_OVERWRITE_OTHER_RSSMENU_DS
    config BR2_TARGET_ROOTFS_RTDIMG_PLAYER_CUSTOM_OVERWRITE_ENCRYPT_RSSMENU_DS
      bool "Encrypt DSS menu"

  endif #BR2_TARGET_ROOTFS_RTDIMG_PLAYER_CUSTOM_OVERWRITE_RSSMENU_DS

endchoice   


config BR2_TARGET_ROOTFS_RTDIMG_PLAYER_CUSTOM_MOVE_RSS_MENU
  bool "Move menu.rss to writable partition (useful during development)"

config BR2_TARGET_ROOTFS_RTDIMG_PLAYER_CUSTOM_PATCH_WEATHER
  bool "Patch the weather files(add Africa)"


endif #BR2_TARGET_ROOTFS_RTDIMG
```

## package/btpd/Config.in
```kconfig
config BR2_PACKAGE_BTPD
	bool "btpd"
	help
		Btpd is a utility for sharing files over the BitTorrent network protocol.
		It runs in daemon mode, thus needing no controlling terminal or gui.
		Instead, the daemon is controlled by btcli, its command line utility,
		or other programs capable of sending commands and queries on the control
		socket.
			
	
		https://github.com/btpd/btpd
```

## package/gnupth/Config.in
```kconfig
config BR2_PACKAGE_GNUPTH
	bool "gnupth"
	help
	 Pth is a very portable POSIX/ANSI-C based library for Unix platforms which provides non-preemptive priority-based scheduling for multiple threads of execution (aka ``multithreading'') inside event-driven applications

	 http://www.gnu.org/software/pth/
```

## package/gpg/Config.in
```kconfig
config BR2_PACKAGE_GPG
	bool "gpg"
	help
	 GnuPG

	 http://www.gnupg.org/download/index.en.html#gpg
```

## package/gpgme/Config.in
```kconfig
config BR2_PACKAGE_GPGME
	bool "gpgme"
	select BR2_PACKAGE_LIBGPG_ERROR
	help
	 GnuPG Made Easy is a library designed to make access to GnuPG easier for applications	

	 http://www.gnupg.org/download/index.en.html#gpgme
```

## package/libassuan/Config.in
```kconfig
config BR2_PACKAGE_LIBASSUAN
	bool "libassuan"
	help
	 Libassuan is the IPC library used by some GnuPG related software.	

	 http://www.gnupg.org/download/index.en.html#libassuan
```

## package/libksba/Config.in
```kconfig
config BR2_PACKAGE_LIBKSBA
	bool "libksba"
	help
	 Libksba is a CMS and X.509 access library under development.

	 http://www.gnupg.org/download/index.en.html#libksba
```

## package/libpar2/Config.in
```kconfig
config BR2_PACKAGE_LIBPAR2
	bool "libpar2"
	help
                Libpar2 is a library for manipulating par2 files

                http://sourceforge.net/projects/parchive/
```

## package/mc/Config.in
```kconfig
config BR2_PACKAGE_MC
	bool "mc"
	help

                Midnight Commander is a file manager for free operating systems

                http://www.gnu.org/s/mc/
```

## package/openrtd/Config.in
```kconfig
menu "OpenRTD specific packages"

menu "Streaming feeds"
source "package/openrtd/vb6scripts/Config.in"
source "package/openrtd/rssEx/Config.in"
source "package/openrtd/xLive/Config.in"
source "package/openrtd/xVod/Config.in"
endmenu
source "package/openrtd/WebControlPanel/Config.in"
source "package/openrtd/rssControlPanel/Config.in"
endmenu
```

## package/openrtd/nzbget/Config.in
```kconfig
config BR2_PACKAGE_NZBGET
	bool "nbzget"
	help
                NZBGet is a command-line based binary newsgrabber for nzb files, written in C++.
		
		http://nzbget.sourceforge.net/Main_Page
```

## package/opkg/Config.in
```kconfig
config BR2_PACKAGE_OPKG
	bool "opkg"
	depends on BR2_PACKAGE_GPGME
	help
	  Opkg is a lightweight package management system. It is written in C and resembles apt/dpkg in operation	  

	  http://code.google.com/p/opkg/
```

## package/phpfm/Config.in
```kconfig
config BR2_PACKAGE_PHPFM
	bool "phpfm"
	help
		phpFileManager is a complete filesystem management tool on a single file.		

		http://phpfm.sourceforge.net
```

## package/transmission/Config.in
```kconfig
config BR2_PACKAGE_TRANSMISSION
	bool "transmission"
	select BR2_PACKAGE_ZLIB
	select BR2_PACKAGE_OPENSSL
	select BR2_PACKAGE_LIBCURL
	select BR2_PACKAGE_LIBEVENT
	help
	  Transmission is a cross-platform BitTorrent client.

if BR2_PACKAGE_TRANSMISSION

config BR2_PACKAGE_TRANSMISSION_UTP
	bool "Transmission uTP support"
	depends on BR2_INSTALL_LIBSTDCPP
	help
	  Install support for uTorrent Transport Protocol

comment "uTP requires a toolchain with C++ support"
	depends on !BR2_INSTALL_LIBSTDCPP

config BR2_PACKAGE_TRANSMISSION_CLI
	bool "transmission-cli"
	help
	  Install transmission command line interface.

config BR2_PACKAGE_TRANSMISSION_DAEMON
	bool "transmission-daemon"
	help
	  Install transmission daemon.
if BR2_PACKAGE_TRANSMISSION_DAEMON
    choice
      prompt "Choose transmission daemon startup script"

      config BR2_PACKAGE_TRANSMISSION_DAEMON_ORIGINAL_STARTUP_SCRIPT
        bool "Original Transmission startup script"
      config BR2_PACKAGE_TRANSMISSION_DAEMON_OPENRTD_STARTUP_SCRIPT
        bool "OpenRTD(simpler) Transmission startup script"	
    endchoice
endif 


config BR2_PACKAGE_TRANSMISSION_REMOTE
	bool "transmission-remote"
	help
	  Install transmission remote management tool.

config BR2_PACKAGE_TRANSMISSION_GTK
	bool "transmission-gtk"
	depends on BR2_PACKAGE_LIBGTK2 && BR2_ENABLE_LOCALE
	help
	  Install transmission GTK-based GUI interface.

comment "transmission-gtk requires a toolchain with locale support"
	depends on BR2_PACKAGE_LIBGTK2 && !BR2_ENABLE_LOCALE
endif
```

## package/unrar/Config.in
```kconfig
config BR2_PACKAGE_UNRAR
	bool "unrar"
	help
		RAR is a powerful archive manager

		http://www.rarlab.com/
```
